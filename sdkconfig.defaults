## sdkconfig.defaults
```kconfig
# Flash: 8MB
CONFIG_ESPTOOLPY_FLASHSIZE_8MB=y
CONFIG_ESPTOOLPY_FLASHSIZE="8MB"

# Flash mode: keep DIO for N8R8
CONFIG_ESPTOOLPY_FLASHMODE_DIO=y

# PSRAM: 8MB Octal
CONFIG_SPIRAM=y
CONFIG_SPIRAM_MODE_OCT=y
CONFIG_SPIRAM_TYPE_AUTO=y
CONFIG_SPIRAM_SPEED_80M=y

# Partition table: use full 8MB
CONFIG_PARTITION_TABLE_SINGLE_APP_LARGE=y

CONFIG_ESP_CONSOLE_USB_CDC=y
CONFIG_ESP_CONSOLE_SECONDARY_NONE=y

# Bluetooth – NimBLE with BLE 5.0 Coded PHY (Long Range)
CONFIG_BT_ENABLED=y
CONFIG_BT_NIMBLE_ENABLED=y
CONFIG_BT_NIMBLE_50_FEATURE_SUPPORT=y
CONFIG_BT_NIMBLE_EXT_ADV=y
CONFIG_BT_LOG_NIMBLE_HOST_LOG_LEVEL_ERROR=y
CONFIG_BT_LOG_NIMBLE_HOST_LOG_LEVEL=0
CONFIG_BT_NIMBLE_LOG_LEVEL_WARNING=y
CONFIG_BT_NIMBLE_LOG_LEVEL=3

# WiFi + Bluetooth coexistence
CONFIG_ESP_COEX_SW_COEXIST_ENABLE=y

# Reduce WiFi internal SRAM usage (critical for BLE+WiFi+Camera)
CONFIG_ESP_WIFI_STATIC_RX_BUFFER_NUM=4
CONFIG_ESP_WIFI_DYNAMIC_RX_BUFFER_NUM=16
CONFIG_ESP_WIFI_STATIC_TX_BUFFER_NUM=4
CONFIG_ESP_WIFI_AMPDU_TX_ENABLED=n
CONFIG_ESP_WIFI_AMPDU_RX_ENABLED=n

# Allow WiFi/LWIP buffers in PSRAM
CONFIG_SPIRAM_TRY_ALLOCATE_WIFI_LWIP=y

# Enable IP reassembly so the remote can receive fragmented UDP datagrams
CONFIG_LWIP_IP4_REASSEMBLY=y
CONFIG_LWIP_IP_REASS_MAX_PBUFS=16

# Camera: use PSRAM for DMA, reduce DMA buffer, disable unused sensors
CONFIG_CAMERA_DMA_BUFFER_SIZE_MAX=16384
CONFIG_CAMERA_PSRAM_DMA=y
CONFIG_OV7670_SUPPORT=n
CONFIG_OV7725_SUPPORT=n
CONFIG_NT99141_SUPPORT=n
CONFIG_OV2640_SUPPORT=y
CONFIG_OV3660_SUPPORT=n
CONFIG_OV5640_SUPPORT=n
CONFIG_GC2145_SUPPORT=n
CONFIG_GC032A_SUPPORT=n
CONFIG_GC0308_SUPPORT=n
CONFIG_BF3005_SUPPORT=n
CONFIG_BF20A6_SUPPORT=n
CONFIG_SC101IOT_SUPPORT=n
CONFIG_SC030IOT_SUPPORT=n
CONFIG_SC031GS_SUPPORT=n
```
